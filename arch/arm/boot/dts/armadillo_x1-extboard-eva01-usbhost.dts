// SPDX-License-Identifier: GPL-2.0
/*
 * Copyright (C) 2024 Atmark Techno, Inc. All Rights Reserved.
 */

#include "armadillo_x1.dts"

#include "armadillo_x1-extboard-eva01-fec1.dtsi"
#include "armadillo_x1-extboard-eva01-usdhc2.dtsi"
#include "armadillo_x1-extboard-eva01-pca9538.dtsi"
#include "armadillo_x1-extboard-eva01-lcdif.dtsi"
#include "armadillo_x1-extboard-eva01-usbotg2-host.dtsi"
